/*
██╗  ██╗██╗██████╗ ██████╗ ██╗   ██╗
██║ ██╔╝██║██╔══██╗██╔══██╗╚██╗ ██╔╝
█████╔╝ ██║██████╔╝██████╔╝ ╚████╔╝ 
██╔═██╗ ██║██╔══██╗██╔══██╗  ╚██╔╝  
██║  ██╗██║██║  ██║██████╔╝   ██║   
╚═╝  ╚═╝╚═╝╚═╝  ╚═╝╚═════╝    ╚═╝   

Created by Pucur

https://github.com/Pucur/Wifi-Gochi/

Version: 1.2
*/

#include <Adafruit_SSD1306.h>
#include <WiFi.h>
#include <SPIFFS.h>
#include <WebServer.h>
#include <RTClib.h>
#include <Adafruit_NeoPixel.h>
#include <Wire.h>
#include <pgmspace.h>
#include <Preferences.h>

#define LED_PIN 10
#define NUM_LEDS 1
#define SCREEN_WIDTH 128
#define SCREEN_HEIGHT 64
#define OLED_RESET -1
#define BUZZER_PIN 2
#define KNOWN_MAX 128
#define SDA_PIN 1
#define SCL_PIN 0
#define MAX_TOP_MESSAGES 5
#define MAX_RAM_SSIDS 50
#define BLOOM_SIZE 8192

char topQueue[MAX_TOP_MESSAGES][64];
unsigned long msgTimestamps[MAX_TOP_MESSAGES];
int msgCount = 0;

Adafruit_NeoPixel strip(NUM_LEDS, LED_PIN, NEO_GRB + NEO_KHZ800);

// Neopixel
uint8_t red = 255, green = 0, blue = 0;
unsigned long lastFadeUpdate = 0;
const unsigned long fadeInterval = 20;
float hue = 0;

// SSIDs in RAM
char ramSSIDs[MAX_RAM_SSIDS][33];
int ramCount = 0;

// Start webserver
WebServer server(80);

// Paths
const char* WIFI_FILE = "/wifi.txt";
const char* EAT_FILE = "/eat.txt";

uint8_t bloom[BLOOM_SIZE / 8];


RTC_DS3231 rtc;
int fridge = 0;
int total = 0;
int ageDays;
const unsigned long ageUpdateInterval = 86400000;
unsigned long lastAgeUpdate = 0;
DateTime kirbyBirthday(2025, 12, 04, 23, 0, 0); // Birth date
unsigned long lastFrameTime = 0;
const unsigned long frameInterval = 200;
extern const unsigned char* kirbyFrames[];
extern const int numFrames;
int currentFrame = 0;
unsigned long lastFeedTime = 0;
unsigned long kirbyFeedEnableMillis = 0;
bool kirbyFeedEnabled = false;
const unsigned long ThreeHours = 3UL * 60UL * 60UL * 1000UL; // Eat time
const unsigned long msgDuration = 10000;                      // Notification duration
unsigned long lastActiveCountUpdate = 0;
const unsigned long activeCountInterval = 60000;  // Active check

Preferences prefs;

bool isSleeping = false;
bool isMuted = false;
bool isScanning = true;
bool isLedOn = true;
bool isDeepSleeping  = false;
int scrOffFrom = 0, scrOffTo = 0;
int muteOffFrom = 0, muteOffTo = 0;
int scanOffFrom = 0, scanOffTo = 0;
int ledOffFrom = 0, ledOffTo   = 0;
int deepSleepFrom = 0, deepSleepTo = 0;
unsigned long totalEaten = 0;
unsigned long lastCalcUnix = 0;
int lastActiveWifiCount = 0;

// 24 hr to 12 hr
void nowStr12Dot(char* out, size_t sz) {
  DateTime now = rtc.now();
  int hour12 = now.hour() % 12;
  if (hour12 == 0) hour12 = 12;
  const char* dot = (now.hour() >= 12) ? "*" : "";

  snprintf(out, sz, "%02d.%02d.%02d. %02d:%02d:%02d %s",
           now.year() % 100, now.month(), now.day(),
           hour12, now.minute(), now.second(),
           dot);
}

Adafruit_SSD1306 display(SCREEN_WIDTH, SCREEN_HEIGHT, &Wire, OLED_RESET);

// Kirby web logo
const char logo_base64[] PROGMEM =
  "AAAAHGZ0eXBhdmlmAAAAAGF2aWZtaWYxbWlhZgAAAXBtZXRhAAAAAAAAACFoZGxyAAAAAAAAAABw"
  "aWN0AAAAAAAAAAAAAAAAAAAAAA5waXRtAAAAAAABAAAANGlsb2MAAAAAREAAAgABAAAAAAGUAAEA"
  "AAAAAAAI4AACAAAAAAp0AAEAAAAAAAAEQwAAADhpaW5mAAAAAAACAAAAFWluZmUCAAAAAAEAAGF2"
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  "d8/6AJyh+1GWCgjW3HhU+Q7+PHGTqDrI9b8BUeFMB/g1gZuqtzRLPlr0VbAgzfdXPLIj1eWEWrg+"
  "yPv9bOw=";


// 'kirby1', 128x32px
const unsigned char kirby1[] PROGMEM = {
  0x00, 0x00, 0x00, 0x00, 0x00, 0x00, 0x00, 0x00, 0x00, 0x00, 0x00, 0x00, 0x00, 0x00, 0x00, 0x00,
  0x00, 0x00, 0x00, 0x00, 0x00, 0x00, 0x00, 0x00, 0x00, 0x00, 0x00, 0x00, 0x00, 0x00, 0x00, 0x00,
  0x00, 0x00, 0x00, 0x00, 0x00, 0x00, 0x00, 0x00, 0x00, 0x00, 0x00, 0x00, 0x00, 0x00, 0x00, 0x00,
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  0x00, 0x00, 0x00, 0x00, 0x00, 0x03, 0x38, 0x03, 0xe0, 0x00, 0x00, 0x00, 0x00, 0x00, 0x00, 0x00
};
// 'kirby2', 128x32px
const unsigned char kirby2[] PROGMEM = {
  0x00, 0x00, 0x00, 0x00, 0x00, 0x00, 0x00, 0x00, 0x00, 0x00, 0x00, 0x00, 0x00, 0x00, 0x00, 0x00,
  0x00, 0x00, 0x00, 0x00, 0x00, 0x00, 0x00, 0x00, 0x00, 0x00, 0x00, 0x00, 0x00, 0x00, 0x00, 0x00,
  0x00, 0x00, 0x00, 0x00, 0x00, 0x00, 0x00, 0x00, 0x00, 0x00, 0x00, 0x00, 0x00, 0x00, 0x00, 0x00,
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  0x00, 0x00, 0x00, 0x00, 0x00, 0x03, 0xf8, 0x01, 0xc0, 0x00, 0x00, 0x00, 0x00, 0x00, 0x00, 0x00
};
// 'kirby3', 128x32px
const unsigned char kirby3[] PROGMEM = {
  0x00, 0x00, 0x00, 0x00, 0x00, 0x00, 0x00, 0x00, 0x00, 0x00, 0x00, 0x00, 0x00, 0x00, 0x00, 0x00,
  0x00, 0x00, 0x00, 0x00, 0x00, 0x00, 0x00, 0x00, 0x00, 0x00, 0x00, 0x00, 0x00, 0x00, 0x00, 0x00,
  0x00, 0x00, 0x00, 0x00, 0x00, 0x00, 0x00, 0x00, 0x00, 0x00, 0x00, 0x00, 0x00, 0x00, 0x00, 0x00,
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  0x00, 0x00, 0x00, 0x00, 0x00, 0x03, 0x08, 0x03, 0xa0, 0x00, 0x00, 0x00, 0x00, 0x00, 0x00, 0x00
};
// 'kirby4', 128x32px
const unsigned char kirby4[] PROGMEM = {
  0x00, 0x00, 0x00, 0x00, 0x00, 0x00, 0x00, 0x00, 0x00, 0x08, 0x06, 0x00, 0x00, 0x00, 0x00, 0x00,
  0x00, 0x00, 0x00, 0x00, 0x00, 0x00, 0x00, 0x00, 0x00, 0x08, 0x04, 0x00, 0x00, 0x00, 0x00, 0x00,
  0x00, 0x00, 0x00, 0x00, 0x00, 0x00, 0x00, 0x00, 0x00, 0x00, 0x08, 0x00, 0x00, 0x00, 0x00, 0x00,
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  0x00, 0x00, 0x00, 0x00, 0x00, 0x01, 0x18, 0x01, 0xe0, 0x00, 0x04, 0x01, 0x80, 0x31, 0x80, 0x00
};
// 'kirby5', 128x32px
const unsigned char kirby5[] PROGMEM = {
  0x00, 0x00, 0x00, 0x00, 0x00, 0x00, 0x00, 0x00, 0x00, 0x08, 0x00, 0x00, 0x00, 0x00, 0x00, 0x00,
  0x00, 0x00, 0x00, 0x00, 0x00, 0x00, 0x00, 0x00, 0x00, 0x18, 0x00, 0x00, 0x04, 0x00, 0x00, 0x00,
  0x00, 0x00, 0x00, 0x00, 0x00, 0x00, 0x00, 0x00, 0x00, 0x10, 0x00, 0x00, 0x08, 0x00, 0x00, 0x00,
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  0x00, 0x00, 0x00, 0x00, 0x00, 0x00, 0x00, 0x03, 0x20, 0x00, 0x20, 0x00, 0x00, 0x00, 0x00, 0x00
};
// 'kirby6', 128x32px
const unsigned char kirby6[] PROGMEM = {
  0x00, 0x00, 0x00, 0x00, 0x00, 0x00, 0x00, 0x00, 0x00, 0x08, 0x04, 0x00, 0x00, 0x00, 0x00, 0x00,
  0x00, 0x00, 0x00, 0x00, 0x00, 0x00, 0x00, 0x00, 0x00, 0x00, 0x0c, 0x00, 0x00, 0x00, 0x00, 0x00,
  0x00, 0x00, 0x00, 0x00, 0x00, 0x00, 0x01, 0xe0, 0x00, 0x00, 0x18, 0x00, 0x00, 0x00, 0x00, 0x00,
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  0x00, 0x00, 0x00, 0x00, 0x00, 0x01, 0x98, 0x01, 0xc0, 0x00, 0x12, 0x00, 0x00, 0x00, 0x00, 0x00
};
// 'kirby7', 128x32px
const unsigned char kirby7[] PROGMEM = {
  0x00, 0x00, 0x00, 0x00, 0x00, 0x00, 0x00, 0x00, 0x00, 0x10, 0x00, 0x00, 0x00, 0x00, 0x00, 0x00,
  0x00, 0x00, 0x00, 0x00, 0x00, 0x00, 0x00, 0x00, 0x00, 0x00, 0x00, 0x00, 0x00, 0x00, 0x00, 0x00,
  0x00, 0x00, 0x00, 0x00, 0x00, 0x00, 0x01, 0xfc, 0x00, 0x10, 0x00, 0x00, 0x00, 0x00, 0x00, 0x00,
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  0x00, 0x00, 0x00, 0x00, 0x00, 0x00, 0x00, 0x00, 0x00, 0x00, 0x00, 0x00, 0x00, 0x00, 0x00, 0x00
};
// 'kirby8', 128x32px
const unsigned char kirby8[] PROGMEM = {
  0x00, 0x00, 0x00, 0x00, 0x00, 0x00, 0x00, 0x00, 0x00, 0x00, 0x00, 0x00, 0x00, 0x00, 0x00, 0x00,
  0x00, 0x00, 0x00, 0x00, 0x00, 0x00, 0x00, 0x00, 0x00, 0x00, 0x00, 0x00, 0x00, 0x00, 0x00, 0x00,
  0x00, 0x00, 0x00, 0x00, 0x00, 0x00, 0x0f, 0xfc, 0x00, 0x00, 0x00, 0x00, 0x00, 0x00, 0x00, 0x00,
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  0x00, 0x00, 0x00, 0x00, 0x00, 0x00, 0x00, 0x00, 0x00, 0x00, 0x00, 0x00, 0x00, 0x00, 0x00, 0x00
};
// 'kirby9', 128x32px
const unsigned char kirby9[] PROGMEM = {
  0x00, 0x00, 0x00, 0x00, 0x00, 0x00, 0x00, 0x00, 0x00, 0x00, 0x00, 0x00, 0x00, 0x00, 0x00, 0x00,
  0x00, 0x00, 0x00, 0x00, 0x00, 0x00, 0x00, 0x00, 0x00, 0x00, 0x00, 0x00, 0x00, 0x00, 0x00, 0x00,
  0x00, 0x00, 0x00, 0x00, 0x00, 0x00, 0x01, 0xe0, 0x00, 0x00, 0x00, 0x00, 0x00, 0x00, 0x00, 0x00,
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  0x00, 0x00, 0x00, 0x00, 0x00, 0x00, 0x00, 0x00, 0x00, 0x00, 0x00, 0x00, 0x00, 0x00, 0x00, 0x00
};
// 'kirby10', 128x32px
const unsigned char kirby10[] PROGMEM = {
  0x00, 0x00, 0x00, 0x00, 0x00, 0x00, 0x00, 0x00, 0x00, 0x00, 0x00, 0x00, 0x00, 0x00, 0x00, 0x00,
  0x00, 0x00, 0x00, 0x00, 0x00, 0x00, 0x00, 0x00, 0x00, 0x00, 0x00, 0x00, 0x00, 0x00, 0x00, 0x00,
  0x00, 0x00, 0x00, 0x00, 0x00, 0x00, 0x00, 0x00, 0x00, 0x00, 0x00, 0x00, 0x00, 0x00, 0x00, 0x00,
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  0x00, 0x00, 0x00, 0x00, 0x00, 0x00, 0x00, 0x00, 0x00, 0x00, 0x00, 0x00, 0x00, 0x00, 0x00, 0x00
};
// 'kirby11', 128x32px
const unsigned char kirby11[] PROGMEM = {
  0x00, 0x00, 0x00, 0x00, 0x00, 0x00, 0x00, 0x00, 0x00, 0x00, 0x00, 0x00, 0x00, 0x00, 0x00, 0x00,
  0x00, 0x00, 0x00, 0x00, 0x00, 0x00, 0x00, 0x00, 0x00, 0x00, 0x00, 0x00, 0x00, 0x00, 0x00, 0x00,
  0x00, 0x00, 0x00, 0x00, 0x00, 0x00, 0x00, 0x00, 0x00, 0x00, 0x00, 0x00, 0x00, 0x00, 0x00, 0x00,
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  0x00, 0x00, 0x00, 0x00, 0x00, 0x00, 0x00, 0x00, 0x00, 0x00, 0x00, 0x00, 0x00, 0x00, 0x00, 0x00
};
// 'kirby12', 128x32px
const unsigned char kirby12[] PROGMEM = {
  0x00, 0x00, 0x00, 0x00, 0x00, 0x00, 0x00, 0x00, 0x00, 0x00, 0x00, 0x00, 0x00, 0x00, 0x00, 0x00,
  0x00, 0x00, 0x00, 0x00, 0x00, 0x00, 0x00, 0x00, 0x00, 0x00, 0x00, 0x00, 0x00, 0x00, 0x00, 0x00,
  0x00, 0x00, 0x00, 0x00, 0x00, 0x00, 0x00, 0x00, 0x00, 0x00, 0x00, 0x00, 0x00, 0x00, 0x00, 0x00,
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  0x00, 0x00, 0x00, 0x00, 0x00, 0x00, 0x00, 0x00, 0x00, 0x00, 0x00, 0x00, 0x00, 0x00, 0x00, 0x00
};

// Array of all bitmaps for convenience. (Total bytes used to store images in PROGMEM = 6336)
const int kirbyArray_LEN = 12;
const unsigned char* kirbyArray[12] = {
  kirby1,
  kirby2,
  kirby3,
  kirby4,
  kirby5,
  kirby6,
  kirby7,
  kirby8,
  kirby9,
  kirby10,
  kirby11,
  kirby12
};

// Animation handle
const unsigned char* kirbyFrames[] = { kirby1, kirby2, kirby3, kirby4, kirby5, kirby6, kirby7, kirby8, kirby9, kirby10, kirby11, kirby12 };
const int numFrames = sizeof(kirbyFrames) / sizeof(kirbyFrames[0]);

// LED

void hsvToRgb(float h, float s, float v, uint8_t& r, uint8_t& g, uint8_t& b) {
  float c = v * s;
  float x = c * (1 - abs(fmod(h / 60.0, 2) - 1));
  float m = v - c;
  float r1, g1, b1;

  if (h < 60) {
    r1 = c;
    g1 = x;
    b1 = 0;
  } else if (h < 120) {
    r1 = x;
    g1 = c;
    b1 = 0;
  } else if (h < 180) {
    r1 = 0;
    g1 = c;
    b1 = x;
  } else if (h < 240) {
    r1 = 0;
    g1 = x;
    b1 = c;
  } else if (h < 300) {
    r1 = x;
    g1 = 0;
    b1 = c;
  } else {
    r1 = c;
    g1 = 0;
    b1 = x;
  }

  r = (r1 + m) * 255;
  g = (g1 + m) * 255;
  b = (b1 + m) * 255;
}

// LED fade script

void updateLedFade() {
  unsigned long now = millis();
  if (now - lastFadeUpdate >= fadeInterval) {
    lastFadeUpdate = now;

    hue += 1;
    if (hue >= 360) hue = 0;

    hsvToRgb(hue, 1.0, 0.2, red, green, blue);

    strip.setPixelColor(0, strip.Color(red, green, blue));
    strip.show();
  }
}


// Webserver file paths

void handleFile(const char* path) {
  if (!SPIFFS.exists(path)) {
    server.send(404, "text/plain", "Not found");
    return;
  }
  File f = SPIFFS.open(path, "r");
  server.streamFile(f, "text/plain");
  f.close();
}

bool ramContains(const char* ssid) {
  for (int i = 0; i < ramCount; i++) {
    if (strcmp(ramSSIDs[i], ssid) == 0) return true;
  }
  return false;
}

// RAM

void ramAdd(const char* ssid) {
  if (ramContains(ssid)) return;
  if (ramCount < MAX_RAM_SSIDS) {
    strncpy(ramSSIDs[ramCount], ssid, 32);
    ramSSIDs[ramCount][32] = '\0';
    ramCount++;
  } else {
    // FIFO shift
    for (int i = 1; i < MAX_RAM_SSIDS; i++) {
      strncpy(ramSSIDs[i - 1], ramSSIDs[i], 33);
    }
    strncpy(ramSSIDs[MAX_RAM_SSIDS - 1], ssid, 32);
    ramSSIDs[MAX_RAM_SSIDS - 1][32] = '\0';
  }
}


// BLOOM FILTER

uint32_t hash_djb2(const char* str) {
  uint32_t hash = 5381;
  for (const unsigned char* p = (const unsigned char*)str; *p; p++) {
    hash = ((hash << 5) + hash) + *p;  // hash*33 + c
  }
  return hash % BLOOM_SIZE;
}

uint32_t hash_sdbm(const char* str) {
  uint32_t hash = 0;
  for (const unsigned char* p = (const unsigned char*)str; *p; p++) {
    hash = *p + (hash << 6) + (hash << 16) - hash;
  }
  return hash % BLOOM_SIZE;
}

uint32_t hash_xor(const char* str) {
  uint32_t hash = 2166136261u;
  for (const unsigned char* p = (const unsigned char*)str; *p; p++) {
    hash ^= *p;
    hash *= 16777619u;
  }
  return hash % BLOOM_SIZE;
}

void bloomAdd_c(const char* s) {
  char buf[128];
  strncpy(buf, s, sizeof(buf));
  buf[sizeof(buf) - 1] = 0;
  trim(buf);
  if (strlen(buf) == 0) return;

  uint32_t h1 = hash_djb2(buf);
  uint32_t h2 = hash_sdbm(buf);
  uint32_t h3 = hash_xor(buf);
  bloom[h1 / 8] |= (1 << (h1 % 8));
  bloom[h2 / 8] |= (1 << (h2 % 8));
  bloom[h3 / 8] |= (1 << (h3 % 8));
}

bool bloomCheck_c(const char* s) {
  char buf[128];
  strncpy(buf, s, sizeof(buf));
  buf[sizeof(buf) - 1] = 0;
  trim(buf);
  if (strlen(buf) == 0) return false;

  uint32_t h1 = hash_djb2(buf);
  uint32_t h2 = hash_sdbm(buf);
  uint32_t h3 = hash_xor(buf);
  if (!(bloom[h1 / 8] & (1 << (h1 % 8)))) return false;
  if (!(bloom[h2 / 8] & (1 << (h2 % 8)))) return false;
  if (!(bloom[h3 / 8] & (1 << (h3 % 8)))) return false;
  return true;
}

// C-string trim

void trim(char* s) {
  if (!s) return;
  int len = strlen(s);
  while (len > 0 && (s[len - 1] == ' ' || s[len - 1] == '\r' || s[len - 1] == '\n')) {
    s[len - 1] = '\0';
    len--;
  }
  int start = 0;
  while (s[start] == ' ' && start < len) start++;
  if (start > 0) memmove(s, s + start, len - start + 1);
}

// Bloom load

void loadBloomFromFile(const char* path) {
  if (!SPIFFS.exists(path)) return;
  File f = SPIFFS.open(path, "r");
  if (!f) return;

  char line[128];
  while (f.available()) {
    size_t len = f.readBytesUntil('\n', line, sizeof(line) - 1);
    line[len] = 0;
    trim(line);
    if (len == 0 || strlen(line) == 0) continue;

    char* comma = (char*)memchr(line, ',', strlen(line));
    if (comma) *comma = 0;
    trim(line);

    bloomAdd_c(line);
  }
  f.close();
}

// SSIDs append

void appendSSIDToFile_c(const char* ssid) {
  char buf[33];
  strncpy(buf, ssid, sizeof(buf));
  buf[sizeof(buf) - 1] = 0;
  trim(buf);
  if (strlen(buf) == 0) return;

  File f = SPIFFS.open(WIFI_FILE, "a");
  if (!f) return;
  f.printf("%s\n", buf);
  f.close();
}

// SSID scan done

void onScanDone_c(int n) {
  if (n <= 0) return;
  char ssidBuf[33];
  int processed = 0;
  for (int i = 0; i < n; i++) {
    if (processed >= 20) break;

WiFi.SSID(i).toCharArray(ssidBuf, sizeof(ssidBuf));
trim(ssidBuf);
if (strlen(ssidBuf) == 0) continue;

if (bloomCheck_c(ssidBuf)) {
    ramAdd(ssidBuf);
    continue;
}
    trim(ssidBuf);
    if (strlen(ssidBuf) == 0) continue;

    // 1. RAM check
    if (ramContains(ssidBuf)) continue;

    bool foundInFile = false;

    // WiFi.txt read
    if (SPIFFS.exists(WIFI_FILE)) {
      File f = SPIFFS.open(WIFI_FILE, "r");
      if (f) {
        char line[128];
        while (f.available()) {
          int l = f.readBytesUntil('\n', line, sizeof(line) - 1);
          line[l] = 0;
          trim(line);

          char* comma = (char*)memchr(line, ',', strlen(line));
          if (comma) *comma = 0;
          trim(line);

          if (strcmp(line, ssidBuf) == 0) {
            foundInFile = true;
            break;
          }
        }
        f.close();
      }
    }

    // eat.txt read
    if (!foundInFile && SPIFFS.exists(EAT_FILE)) {
      File f = SPIFFS.open(EAT_FILE, "r");
      if (f) {
        char line[128];
        while (f.available()) {
          int l = f.readBytesUntil('\n', line, sizeof(line) - 1);
          line[l] = 0;
          trim(line);

          char* comma = (char*)memchr(line, ',', strlen(line));
          if (comma) *comma = 0;
          trim(line);

          if (strcmp(line, ssidBuf) == 0) {
            foundInFile = true;
            break;
          }
        }
        f.close();
      }
    }

    // Put to ram if contains in any file
    if (foundInFile) {
      ramAdd(ssidBuf);
      continue;
    }

    // If not contains, add to new file
    appendSSIDToFile_c(ssidBuf);
    bloomAdd_c(ssidBuf);
    ramAdd(ssidBuf);
    Serial.printf("Új WiFi talált: %s\n", ssidBuf);
    notifyNewWifi(ssidBuf);
    fridge++;
    total++;
    processed++;
    playMarioCoin();
  }

  WiFi.scanDelete();
  WiFi.scanNetworks(true, true);
}

// BUZZER SONG

void playMarioCoin() {
  if (isMuted) return;

  tone(BUZZER_PIN, 1046, 100);
  delay(120);
  tone(BUZZER_PIN, 1318, 100);
  delay(120);
  tone(BUZZER_PIN, 1568, 150);
  delay(150);
  noTone(BUZZER_PIN);
}

// Kirby feed

void checkKirbyEating() {
  DateTime now = rtc.now();

  long secondsSinceBirth = now.unixtime() - kirbyBirthday.unixtime();
  if (secondsSinceBirth < 0) return;

  unsigned long threeHourBlocks = secondsSinceBirth / (3 * 3600);

  unsigned long expectedTotal = threeHourBlocks;

  while (fridge > 0 && totalEaten < expectedTotal) {
    feedKirby();
    totalEaten++;
  }
}

void feedKirby() {

  if (!SPIFFS.exists(WIFI_FILE)) return;

  File f = SPIFFS.open(WIFI_FILE, "r");
  if (!f) return;

  char firstLine[128] = {0};
  bool hasLine = false;

  // --- Read first valid line ---
  while (f.available()) {
    int l = f.readBytesUntil('\n', firstLine, sizeof(firstLine) - 1);
    firstLine[l] = 0;
    trim(firstLine);
    if (strlen(firstLine) == 0) continue;
    hasLine = true;
    break;
  }
  f.close();
  if (!hasLine) return;

  // --- Append to eat.txt ---
  File e = SPIFFS.open(EAT_FILE, "a");
  if (e) {
    e.println(firstLine);
    e.close();
    Serial.printf("Kirby megette: %s\n", firstLine);
    fridge--;
  }

  // --- Rewrite wifi.txt without the eaten line ---
  File in  = SPIFFS.open(WIFI_FILE, "r");
  File out = SPIFFS.open("/tmp.txt", "w");

  if (in && out) {
    bool skipped = false;
    char line[128];

    while (in.available()) {
      int l = in.readBytesUntil('\n', line, sizeof(line) - 1);
      line[l] = 0;
      trim(line);
      if (strlen(line) == 0) continue;

      if (!skipped && strcmp(line, firstLine) == 0) {
        skipped = true;   // skip only first occurrence
        continue;
      }

      out.println(line);
    }

    in.close();
    out.close();

    SPIFFS.remove(WIFI_FILE);
    SPIFFS.rename("/tmp.txt", WIFI_FILE);
  }
}

// Counting how many SSIDs in the list
int countLines(const char* path) {
  if (!SPIFFS.exists(path)) return 0;

  File f = SPIFFS.open(path, "r");
  if (!f) return 0;

  int count = 0;
  char line[128];

  while (f.available()) {
    int l = f.readBytesUntil('\n', line, sizeof(line) - 1);
    line[l] = 0;
    trim(line);

    if (strlen(line) == 0) continue;
    count++;
  }

  f.close();
  return count;
}

// Notifications

void pushTopMessage(const char* msg) {
  if (msgCount < MAX_TOP_MESSAGES) {
    strncpy(topQueue[msgCount], msg, 63);
    topQueue[msgCount][63] = 0;
    msgTimestamps[msgCount] = millis();
    msgCount++;
  } else {
    for (int i = 1; i < MAX_TOP_MESSAGES; i++) {
      strcpy(topQueue[i - 1], topQueue[i]);
      msgTimestamps[i - 1] = msgTimestamps[i];
    }
    strncpy(topQueue[MAX_TOP_MESSAGES - 1], msg, 63);
    msgTimestamps[MAX_TOP_MESSAGES - 1] = millis();
  }
}

void notifyNewWifi(const char* ssid) {
  char buf[64];
  snprintf(buf, sizeof(buf), "New: %s", ssid);
  pushTopMessage(buf);
}

void notifyKirbyAte(const char* ssid) {
  char buf[64];
  snprintf(buf, sizeof(buf), "Kirby ate: ", ssid);
  pushTopMessage(buf);
}

// Logo 
String getLogoBase64() {
  String s;
  for (unsigned int i = 0; i < sizeof(logo_base64) - 1; i++) {
    s += char(pgm_read_byte_near(logo_base64 + i));
  }
  return s;
}

// Modes and schedules

void toggleSleepMode() {
  if (isSleeping) {
    display.ssd1306_command(SSD1306_DISPLAYON);
    isSleeping = false;
    Serial.println("Wake up! Display ON");
  } else {
    display.ssd1306_command(SSD1306_DISPLAYOFF);
    isSleeping = true;
    Serial.println("Sleep mode ON");
  }
}

void checkSchedulers() {
    DateTime now = rtc.now();
    int h = now.hour();
    int m = now.minute();
    int today = now.day();

    static int lastScreenCheck = -1;
    static int lastMuteCheck   = -1;
    static int lastScanCheck   = -1;
    static int lastLedCheck    = -1;
    static int lastDeepSleepCheck = -1;

    // SCREEN
    if (h == scrOffFrom && m == 0 && lastScreenCheck != today) {
        toggleSleepMode();
        lastScreenCheck = today;
    }

    // MUTE
    if (h == muteOffFrom && m == 0 && lastMuteCheck != today) {
        isMuted = !isMuted;
        lastMuteCheck = today;
    }

    // SCAN
    if (h == scanOffFrom && m == 0 && lastScanCheck != today) {
        isScanning = !isScanning;
        lastScanCheck = today;
    }

    // LED
    if (h == ledOffFrom && m == 0 && lastLedCheck != today) {
        isLedOn = !isLedOn;
        lastLedCheck = today;
    }

// DEEP SLEEP
    if (h == deepSleepFrom && m == 0 && lastDeepSleepCheck != today) {
        isDeepSleeping = true;
        lastDeepSleepCheck = today;

        // OLED off
        display.ssd1306_command(SSD1306_DISPLAYOFF);

        // NeoPixel off
        strip.clear();
        strip.show();

    // Deep sleep time calculate
        int hoursToWake = deepSleepTo - deepSleepFrom;
        if (hoursToWake <= 0) hoursToWake += 24;
        uint64_t sleep_us = (uint64_t)hoursToWake * 3600ULL * 1000000ULL;

        Serial.printf("Entering scheduled Deep Sleep for %d hours...\n", hoursToWake);
        esp_sleep_enable_timer_wakeup(sleep_us);
        esp_deep_sleep_start();
}
}

// Make texts to bold
void printBold(Adafruit_SSD1306& disp, int x, int y, const char* text) {
  disp.setCursor(x, y);
  disp.print(text);
  disp.setCursor(x + 1, y);
  disp.print(text);
}

void setup() {
  kirbyFeedEnableMillis = millis() + 30000; // 30 sec boot delay
  kirbyFeedEnabled = false;
prefs.begin("kirby", false);

isSleeping = prefs.getBool("sleep", false);
isMuted    = prefs.getBool("mute", false);
isScanning = prefs.getBool("scan", true);
isLedOn    = prefs.getBool("led", true);
scrOffFrom  = prefs.getInt("sc_from", 1);
scrOffTo    = prefs.getInt("sc_to", 8);
muteOffFrom = prefs.getInt("mu_from", 0);
muteOffTo   = prefs.getInt("mu_to", 0);
scanOffFrom = prefs.getInt("sa_from", 0);
scanOffTo   = prefs.getInt("sa_to", 0);
isLedOn     = prefs.getBool("led", true);
ledOffFrom  = prefs.getInt("led_from", 0);
ledOffTo    = prefs.getInt("led_to", 0);
deepSleepFrom = prefs.getInt("ds_from", 0);
deepSleepTo   = prefs.getInt("ds_to", 0);

  Wire.begin(SDA_PIN, SCL_PIN);
  Serial.begin(115200);
  delay(1000);
  strip.begin();
  strip.show();
  Serial.println("Setup start");

  // OLED
  if (!display.begin(SSD1306_SWITCHCAPVCC, 0x3C)) {
    Serial.println("Can't start OLED!");
    for (;;)
      ;
  }
  Serial.println("OLED OK");
  display.clearDisplay();
  display.setTextSize(2);
  display.setTextColor(WHITE);
  int16_t x1, y1;
  uint16_t w, h;
  display.getTextBounds("LOADING...", 0, 0, &x1, &y1, &w, &h);
  display.setCursor((SCREEN_WIDTH - w) / 2, (SCREEN_HEIGHT - h) / 2);
  display.println("LOADING...");
  display.setTextSize(1);
  display.getTextBounds("KirbY v1.2", 0, 0, &x1, &y1, &w, &h);
  display.setCursor((SCREEN_WIDTH - w) / 2, (SCREEN_HEIGHT - h) / 2 + 20);
  display.println("KirbY v1.2");
  display.display();

  // DS3231 init

  if (!rtc.begin()) {
    Serial.println("Cannot find DS3231!");
    for (;;)
      ;
  }

  if (rtc.lostPower()) {
    Serial.println("RTC lost time, configuring it...");
    rtc.adjust(DateTime(F(__DATE__), F(__TIME__)));
  }

  // Force time set
  //rtc.adjust(DateTime(F(__DATE__), F(__TIME__)));

  DateTime now = rtc.now();
  Serial.printf("RTC start time: %04d-%02d-%02d %02d:%02d:%02d\n",
                now.year(), now.month(), now.day(),
                now.hour(), now.minute(), now.second());

  long secondsDiff = long(now.unixtime()) - long(kirbyBirthday.unixtime());
  ageDays = secondsDiff / 86400;
  Serial.printf("Now: %u, Birthday: %u, Days: %ld\n",
                now.unixtime(), kirbyBirthday.unixtime(), ageDays);


  if (!SPIFFS.begin(true)) {
    Serial.println("SPIFFS not accessible!");
    return;
  }

  if (!SPIFFS.exists(WIFI_FILE)) {
    File f = SPIFFS.open(WIFI_FILE, "w");  // "w" -> create if not existing
    if (f) {
      Serial.println("wifi.txt created.");
      f.close();
    } else {
      Serial.println("Canot create wifi.txt file!");
    }
  } else {
    Serial.println("wifi.txt exists.");
  }

  // Bloom filter
File ffo = SPIFFS.open(WIFI_FILE, "r");
if (ffo) {
  char line[128];

  while (ffo.available()) {
    int l = ffo.readBytesUntil('\n', line, sizeof(line) - 1);
    line[l] = 0;
    trim(line);

    if (strlen(line) == 0) continue;

    char* comma = strchr(line, ',');
    if (comma) *comma = 0;
    trim(line);

    if (strlen(line) == 0) continue;

    bloomAdd_c(line);
  }
  ffo.close();
}

  // CREATE EAT.TXT

  if (!SPIFFS.exists(EAT_FILE)) {
    File f = SPIFFS.open(EAT_FILE, "w");  // "w" -> create if not existing
    if (f) {
      Serial.println("eat.txt created.");
      f.close();
    } else {
      Serial.println("Canot create eat.txt file!");
    }
  } else {
    Serial.println("eat.txt exists.");
  }
  Serial.println("SPIFFS OK");
  fridge = countLines(WIFI_FILE);
  total = countLines(EAT_FILE) + fridge;

  // WIFI
  WiFi.mode(WIFI_AP_STA);
  WiFi.setSleep(false);
  WiFi.setAutoReconnect(true);
  WiFi.softAP("Kirby", "hungryshaman", 6, false, 4); // Kirby wifi SSID name and password to connect
  Serial.print("AP IP: ");
  Serial.println(WiFi.softAPIP());

  WiFi.scanNetworks(true, true);

  Serial.println("Setup end");
  playMarioCoin();

  // WEBSERVER

  server.on("/wifi.txt", []() {
    handleFile("/wifi.txt");
  });
  server.on("/eat.txt", []() {
    handleFile("/eat.txt");
  });
server.on("/toggleSleep", []() {
    toggleSleepMode();
    prefs.putBool("sleep", isSleeping);
    server.sendHeader("Location", "/");
    server.send(303);
});

server.on("/toggleMute", []() {
    isMuted = !isMuted;
    prefs.putBool("mute", isMuted);
    server.sendHeader("Location", "/");
    server.send(303);
});
server.on("/toggleLed", []() {
    isLedOn = !isLedOn;
    prefs.putBool("led", isLedOn);
    server.sendHeader("Location", "/");
    server.send(303);
});
server.on("/toggleScan", []() {
    isScanning = !isScanning;
    prefs.putBool("scan", isScanning);
    server.sendHeader("Location", "/");
    server.send(303);
});
server.on("/setScheduler", []() {
    if (server.hasArg("scFrom"))  scrOffFrom  = server.arg("scFrom").toInt();
    if (server.hasArg("scTo"))    scrOffTo    = server.arg("scTo").toInt();
    if (server.hasArg("muFrom"))  muteOffFrom = server.arg("muFrom").toInt();
    if (server.hasArg("muTo"))    muteOffTo   = server.arg("muTo").toInt();
    if (server.hasArg("saFrom"))  scanOffFrom = server.arg("saFrom").toInt();
    if (server.hasArg("saTo"))    scanOffTo   = server.arg("saTo").toInt();
    if (server.hasArg("lFrom")) ledOffFrom = server.arg("lFrom").toInt();
    if (server.hasArg("lTo"))   ledOffTo   = server.arg("lTo").toInt();
    if (server.hasArg("dsFrom")) deepSleepFrom = server.arg("dsFrom").toInt();
    if (server.hasArg("dsTo"))   deepSleepTo   = server.arg("dsTo").toInt();

    prefs.putInt("led_from", ledOffFrom);
    prefs.putInt("led_to",   ledOffTo);
    prefs.putInt("sc_from", scrOffFrom);
    prefs.putInt("sc_to",   scrOffTo);
    prefs.putInt("mu_from", muteOffFrom);
    prefs.putInt("mu_to",   muteOffTo);
    prefs.putInt("sa_from", scanOffFrom);
    prefs.putInt("sa_to",   scanOffTo);
    prefs.putInt("ds_from", deepSleepFrom);
    prefs.putInt("ds_to",   deepSleepTo);
    server.sendHeader("Location", "/");
    server.send(303);
});

server.on("/", []() {
    server.setContentLength(CONTENT_LENGTH_UNKNOWN);
    server.send(200, "text/html", "");

    const char* htmlStart = R"rawliteral(
<!DOCTYPE html>
<html lang="en">
<head>
<meta charset="UTF-8">
<title>Kirby Dashboard</title>)rawliteral";
server.sendContent("<link rel=\"icon\" type=\"image/png\" href=\"data:image/png;base64," + getLogoBase64() + "\">");
const char* htmlMid = R"rawliteral(
<style>
body { font-family: Arial, sans-serif; display: flex; flex-direction: column; align-items: center; justify-content: flex-start; min-height: 100vh; margin:0; padding:0; background: linear-gradient(to bottom, #a0e7ff, #ffffff); }
h1 { color: #ff69b4; margin-top: 20px; }
h2 { color: #333; margin-bottom: 5px; }
iframe { width:90%; height:200px; border:2px solid #333; margin:10px auto; display:block; background-color:#fff8ff; }
img { width:150px; margin:10px auto; display:block; }
button { font-size:18px; margin:10px; padding:10px 20px; cursor:pointer; border-radius:10px; border:none; }
</style>
</head>
<body>
<h1>Kirby WiFi Dashboard</h1>
)rawliteral";

    server.sendContent(htmlStart);
    server.sendContent(htmlMid);

    server.sendContent("<img src=\"data:image/avif;base64," + getLogoBase64() + "\" alt=\"Kirby\">");
    server.sendContent("<p>Active WiFi: " + String(lastActiveWifiCount) + "</p>");

    String settings = "<div style=\"text-align:center;margin:10px;\"><button onclick=\"toggleSettings()\">⚙️ SETTINGS</button></div>";
    settings += "<div id=\"settingsPanel\" style=\"display:none;width:90%;max-width:450px;margin:auto;background:#fff;border-radius:15px;padding:15px;text-align:center;\">";
    settings += "<form action=\"/toggleSleep\"><button style=\"" + String(isSleeping ? "background-color:#f44336;color:white;" : "background-color:#4caf50;color:white;") + "\">" + String(isSleeping ? "🌙 Screen OFF" : "☀️ Screen ON") + "</button></form>";
    settings += "<form action=\"/toggleMute\"><button style=\"" + String(isMuted ? "background-color:#f44336;color:white;" : "background-color:#4caf50;color:white;") + "\">" + String(isMuted ? "🔇 Mute" : "🔊 Unmuted") + "</button></form>";
    settings += "<form action=\"/toggleLed\"><button style=\"" + String(isLedOn ? "background-color:#4caf50;color:white;" : "background-color:#f44336;color:white;") + "\">💡 LED " + String(isLedOn ? "ON" : "OFF") + "</button></form>";
    settings += "<form action=\"/toggleScan\"><button style=\"" + String(isScanning ? "background-color:#4caf50;color:white;" : "background-color:#f44336;color:white;") + "\">📡 Scan " + String(isScanning ? "ON" : "OFF") + "</button></form>";
    settings += "<hr><button onclick=\"toggleScheduler()\">⏱️ Scheduler</button>";
    server.sendContent(settings);

    const char* htmlEnd = R"rawliteral(
<div id="schedulerPanel" style="display:none;margin-top:10px;">
<form action="/setScheduler">
<h3>🌞 Screen scheduler</h3>
From <input type="number" name="scFrom" min="0" max="23" value="0"> To <input type="number" name="scTo" min="0" max="23" value="23"><br>
<h3>🔊 Sound scheduler</h3>
From <input type="number" name="muFrom" min="0" max="23" value="0"> To <input type="number" name="muTo" min="0" max="23" value="23"><br>
<h3>📡 Scan scheduler</h3>
From <input type="number" name="saFrom" min="0" max="23" value="0"> To <input type="number" name="saTo" min="0" max="23" value="23"><br>
<h3>💡 LED scheduler</h3>
From <input type="number" name="leFrom" min="0" max="23" value="0"> To <input type="number" name="leTo" min="0" max="23" value="23"><br>
<h3>😴 Deep Sleep scheduler</h3>
From <input type="number" name="dsFrom" min="0" max="23" value="0"> To <input type="number" name="dsTo" min="0" max="23" value="23"><br>
<br><button type="submit">💾 Save scheduler</button>
</form>
</div></div>

<script>
function toggleSettings(){let s=document.getElementById('settingsPanel');s.style.display=(s.style.display=='none')?'block':'none';}
function toggleScheduler(){let s=document.getElementById('schedulerPanel');s.style.display=(s.style.display=='none')?'block':'none';}
</script>

<h2>Known WiFis</h2><iframe src="/wifi.txt"></iframe>
<h2>Eaten WiFis</h2><iframe src="/eat.txt"></iframe>

<h1>Created by Pucur with ❤️ ~~ version 1.2</h1>
<script>
let titleText='⢀⣀⠤⠤⠒⠒⠒ Kirby Dashboard ⠒⠒⠒⠤⢤⣀';let pos=0;
function moveTitle(){document.title=titleText.substring(pos)+titleText.substring(0,pos);pos=(pos+1)%titleText.length;}
setInterval(moveTitle,150);
</script>
</body></html>
)rawliteral";
    server.sendContent(htmlEnd);
});


  server.begin();
  Serial.println("HTTP server started");
  totalEaten = countLines(EAT_FILE);

  if (isSleeping) {
    display.ssd1306_command(SSD1306_DISPLAYOFF);
    Serial.println("Setup: Screen OFF, isSleeping = true");
} else {
    display.ssd1306_command(SSD1306_DISPLAYON);
    Serial.println("Setup: Screen ON, isSleeping = false");
}


}

void loop() {
  server.handleClient();
  char buf[32];
  uint32_t freeHeap = ESP.getFreeHeap();
  if (freeHeap < 15000) {
    Serial.printf("LOW HEAP: %u – scan skipped\n", freeHeap);
    return;
  }
  unsigned long nowMillis = millis();

// Wifi scanning
if (isScanning) {

  int n = WiFi.scanComplete();

  if (n == WIFI_SCAN_FAILED) {
    WiFi.scanNetworks(true);
  }

  if (n >= 0) {
    lastActiveWifiCount = n;
    onScanDone_c(n);
    WiFi.scanNetworks(true);
  }

} else {
  WiFi.scanDelete();
}
  // Update age
  if (nowMillis - lastAgeUpdate >= ageUpdateInterval) {
    DateTime now = rtc.now();
    long secondsDiff = long(now.unixtime()) - long(kirbyBirthday.unixtime());
    ageDays = secondsDiff / 86400;
    lastAgeUpdate = nowMillis;
  }

  // Check kirby feed time
  
  if (!kirbyFeedEnabled) {
  if (millis() >= kirbyFeedEnableMillis) {
    kirbyFeedEnabled = true;
    Serial.println("Kirby feeding enabled after boot delay");
  }
}

if (kirbyFeedEnabled) {
  checkKirbyEating();
}
  checkSchedulers();

  // Frame updates
  if (nowMillis - lastFrameTime >= frameInterval) {
    lastFrameTime = nowMillis;
    display.clearDisplay();

    // TOP notification
    display.setTextSize(1);
    display.setTextColor(WHITE);
    display.setCursor(0, 0);

    if (msgCount > 0) {
      if (millis() - msgTimestamps[0] >= msgDuration) {

        // FIFO shift
        for (int i = 1; i < msgCount; i++) {
          strcpy(topQueue[i - 1], topQueue[i]);
          msgTimestamps[i - 1] = msgTimestamps[i];
        }

        msgCount--;

        if (msgCount > 0) {
          topQueue[msgCount][0] = '\0';
        }
      }
      printBold(display, 0, 0, topQueue[0]);
    } else {
      snprintf(buf, sizeof(buf), "Active WiFis: %d", lastActiveWifiCount);
      printBold(display, 0, 0, buf);
    }

    display.setFont();
    // Kirby animation
    display.drawBitmap(-35, 16, kirbyFrames[currentFrame], SCREEN_WIDTH, 32, WHITE);

    // Info bar
    snprintf(buf, sizeof(buf), "Age:   %d d", ageDays);
    printBold(display, 50, 16, buf);
    snprintf(buf, sizeof(buf), "Yumy:  %d", fridge);
    printBold(display, 50, 26, buf);
    snprintf(buf, sizeof(buf), "Total: %d", total);
    printBold(display, 50, 36, buf);
    nowStr12Dot(buf, sizeof(buf));
    printBold(display, 0, 52, buf);

    display.display();
    currentFrame = (currentFrame + 1) % numFrames;

    // NeoPixel fade
    if (isLedOn) {
      updateLedFade();
    } else {
      strip.clear();
      strip.show();
    }
  }
}
